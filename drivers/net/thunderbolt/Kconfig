## drivers/net/thunderbolt/Kconfig
```kconfig
# SPDX-License-Identifier: GPL-2.0-only
config USB4_NET
	tristate "Networking over USB4 and Thunderbolt cables"
	depends on USB4 && INET
	help
	  Select this if you want to create network between two computers
	  over a USB4 and Thunderbolt cables. The driver supports Apple
	  ThunderboltIP protocol and allows communication with any host
	  supporting the same protocol including Windows and macOS.

	  To compile this driver a module, choose M here. The module will be
	  called thunderbolt_net.

config USB4_NET_KUNIT_TEST
	bool "KUnit tests for USB4 networking" if !KUNIT_ALL_TESTS
	depends on USB4_NET && KUNIT=y
	default KUNIT_ALL_TESTS
	help
	  Builds the thunderbolt_net login-handshake KUnit tests into the module
	  (they run at module load on a CONFIG_KUNIT kernel). Mirrored on-host by
	  tests/tbnet_login_userspace.c for kernels without CONFIG_KUNIT.
```

## drivers/thunderbolt_frame/rxe/Kconfig
```kconfig
# SPDX-License-Identifier: GPL-2.0
config RDMA_THUNDERBOLT_FRAME_RXE
	tristate "rxe-derived RDMA engine over the thunderbolt_frame service"
	depends on INFINIBAND
	select CRC32
	help
	  Soft RDMA provider forked from the rdma_rxe driver with its
	  UDP/IP network transport replaced by the thunderbolt_frame
	  lossless frame service on Thunderbolt/USB4 XDomain DMA rings.
	  The uverbs ABI and driver id are unchanged, so the rdma-core
	  usb4-rdma-provider remains the userspace provider. See
	  drivers/thunderbolt_frame/docs/frame-rxe-wire-spec.md.
```

## drivers/thunderbolt_ibverbs/kernel/tbrxe/Kconfig
```kconfig
# SPDX-License-Identifier: GPL-2.0
config RDMA_TBRXE
	tristate "rxe-derived RDMA engine over the tbframe Thunderbolt frame service"
	depends on INFINIBAND
	select CRC32
	help
	  Soft RDMA provider forked from the rdma_rxe driver with its
	  UDP/IP network transport replaced by the tbframe lossless frame
	  service on Thunderbolt/USB4 XDomain DMA rings. The uverbs ABI and
	  driver id are unchanged, so stock rdma-core librxe remains the
	  userspace provider. See
	  drivers/thunderbolt_ibverbs/docs/tbframe-tbrxe-wire-spec.md.
```
